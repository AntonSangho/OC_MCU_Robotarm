#include <Servo.h> // 서보모터 제어를 위한 라이브러리 포함

Servo servo1; // 서보모터 1 객체 생성
Servo servo2; // 서보모터 2 객체 생성
int ang1 = 90; // 서보모터 1의 초기 각도
int ang2 = 90; // 서보모터 2의 초기 각도

void setup() {
  Serial.begin(9600); // 시리얼 통신을 9600bps로 시작
  servo1.attach(7); // 서보모터 1을 핀 7에 연결
  servo2.attach(6); // 서보모터 2를 핀 6에 연결
  servo1.write(90); // 서보모터 1을 90도로 설정
  servo2.write(90); // 서보모터 2를 90도로 설정
}

void loop() {
  // 서보모터 1 제어
  if (analogRead(0) < 200 && ang1 < 180) { // 아날로그 핀 0의 값이 200 미만이고, 서보모터 1의 각도가 180도 미만일 때
    ang1++; // 서보모터 1의 각도를 1도 증가
    servo1.write(ang1); // 서보모터 1에 새로운 각도 설정
  }
  if (analogRead(0) > 700 && ang1 > 0) { // 아날로그 핀 0의 값이 700 초과하고, 서보모터 1의 각도가 0도 초과일 때
    ang1--; // 서보모터 1의 각도를 1도 감소
    servo1.write(ang1); // 서보모터 1에 새로운 각도 설정
  }

  // 서보모터 2 제어
  if (analogRead(1) < 200 && ang2 < 180) { // 아날로그 핀 1의 값이 200 미만이고, 서보모터 2의 각도가 180도 미만일 때
    ang2++; // 서보모터 2의 각도를 1도 증가
    servo2.write(ang2); // 서보모터 2에 새로운 각도 설정
  }
  if (analogRead(1) > 700 && ang2 > 0) { // 아날로그 핀 1의 값이 700 초과하고, 서보모터 2의 각도가 0도 초과일 때
    ang2--; // 서보모터 2의 각도를 1도 감소
    servo2.write(ang2); // 서보모터 2에 새로운 각도 설정
  }

  delay(15); // 15ms 대기
}
